## CMakeLists.txt
```
# SPDX-License-Identifier: Apache-2.0
set(CMAKE_VERBOSE_MAKEFILE ON)

list(APPEND ZEPHYR_EXTRA_MODULES ../libzmq/)

cmake_minimum_required(VERSION 3.13.1)

include($ENV{ZEPHYR_BASE}/cmake/app/boilerplate.cmake NO_POLICY_SCOPE)
project(hello_world)

target_sources(app PRIVATE src/main.cpp)
```

## prj.conf
```kconfig
# General config
CONFIG_CPLUSPLUS=y
CONFIG_NEWLIB_LIBC=y
CONFIG_LIB_CPLUSPLUS=y
#CONFIG_MINIMAL_LIBC_MALLOC_ARENA_SIZE=128
CONFIG_ENTROPY_DEVICE_RANDOM_GENERATOR=y

# pthreads
CONFIG_EXTERNAL_LIBC=n
CONFIG_POSIX_API=y
CONFIG_PTHREAD_IPC=y
CONFIG_POSIX_MQUEUE=y
CONFIG_APP_LINK_WITH_POSIX_SUBSYS=y

# networking
CONFIG_NETWORKING=y
CONFIG_NET_IPV4=y
# CONFIG_NET_IPV6 is not set
CONFIG_NET_TCP=y
CONFIG_NET_SOCKETS=y
#CONFIG_NET_SOCKETS_POSIX_NAMES=y
#CONFIG_MINIMAL_LIBC_MALLOC_ARENA_SIZE=131072
CONFIG_NET_TX_STACK_SIZE=8192
CONFIG_NET_RX_STACK_SIZE=8192
CONFIG_ISR_STACK_SIZE=8192
CONFIG_MAIN_STACK_SIZE=8192
CONFIG_IDLE_STACK_SIZE=2048

CONFIG_DNS_RESOLVER=y

CONFIG_NET_CONFIG_SETTINGS=y
CONFIG_NET_CONFIG_MY_IPV4_ADDR="10.0.0.111"
CONFIG_NET_CONFIG_MY_IPV4_NETMASK="255.255.255.0"
CONFIG_NET_CONFIG_MY_IPV4_GW="10.0.0.116"
CONFIG_NET_CONFIG_PEER_IPV4_ADDR="10.0.0.116"

# logging
CONFIG_NET_LOG=y
```

## src/main.cpp
```c
/*
 * Copyright (c) 2017 Intel Corporation
 *
 * SPDX-License-Identifier: Apache-2.0
 */

/* hello world example: calling functions from a static library */


#include <stdio.h>
#include <zephyr.h>
#include <arch/cpu.h>
#include <sys/printk.h>

//#include <zmq.hpp>
#include <zmq.h>

void main(void)
{
    void *context = zmq_ctx_new ();
//    zmq::context_t context(1);
	printk("Hello World!\n");
}
```
